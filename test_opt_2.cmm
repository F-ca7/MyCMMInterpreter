func main() void{
	int x = 100;
	int sum = 0;
    int y = 5;
    int z = 55;

    while(y<100) {
        y=y+1;
        print 1;
    }
	return;
}

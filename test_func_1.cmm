func main() void {
	char c = 'a';
	print c;
	int arr[5];
	arr[0] = 1;
	arr[1] = 2;
	print arr;
}


func main() void{
	if(1>99) {
		print 1;
	} else if (5 >4) {
        print 2;
    } else if (100>55) {
        print 3;
    }  else {
		print 4;
	}
	return;
}

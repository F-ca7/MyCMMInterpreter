func main() void{
    int x = 0;
    print x;
    int x =99;
    real x = 100;
}


func main() void{
    int a = 2*5+-1;
    55 = 66+x;
    print a;
    int x = 55
    if(a==0 {)
        while(x*y>0 {
            i = 5;
        }
        break;
        int b = 9
    }
}

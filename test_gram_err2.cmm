func main() void {
    int a = *2*5+-1;
    print a;
    int x = 55
    if(a==0 {
        int b = 9;
        55 = b;
    }
    int b = 5+arr[3]-10;
    int c = 5+(arr[3)]-10;
    int m = add(1,2);
    int n = minus(3, 4);
    return;
}

func add(int a, int b) int{
    int x = a+b;

}
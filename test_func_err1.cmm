func main() void{
    int a[5];
    int index = 5-10;
    a[4] = 55;
    int x = a[0];
    print x;
}


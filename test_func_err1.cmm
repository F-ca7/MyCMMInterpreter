func main() void{
    int a[5];
    int index = 5-10;
    a[index] = 55;
    print x;
}

